## boards/shields/mantis/Kconfig.defconfig
```kconfig
# Copyright (c) 2024 Joshua Lucas
# SPDX-License-Identifier: MIT

if SHIELD_MANTIS

config ZMK_KEYBOARD_NAME
	default "Mantis"

endif
```

## boards/shields/mantis/Kconfig.shield
```kconfig
# Copyright (c) 2024 Joshua Lucas
# SPDX-License-Identifier: MIT

config SHIELD_MANTIS
	def_bool $(shields_list_contains,mantis)
```

## config/west.yml
```yaml
manifest:
  remotes:
    - name: zmkfirmware
      url-base: https://github.com/zmkfirmware
    # Additional modules containing boards/shields/custom code can be listed here as well
    # See https://docs.zephyrproject.org/3.2.0/develop/west/manifest.html#projects
    - name: davidphilipbarr
      url-base: https://github.com/davidphilipbarr
  projects:
    - name: zmk
      remote: zmkfirmware
      revision: main
      import: app/west.yml
    - name: nicehatharry
      remote: davidphilipbarr
      clone-depth: 1
      revision: main
  self:
    path: config
```
